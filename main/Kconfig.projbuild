## main/Kconfig.projbuild
```kconfig
menu "Bin Light Configuration"

    config BINLIGHT_WIFI_SSID
        string "Wi-Fi SSID (optional, development only)"
        default ""
        help
            Optional since AutoAP provisioning landed (SPEC.md 3.4). Leave
            empty for normal builds: the device will raise its own setup
            network and be provisioned from a browser, and those credentials
            are stored in NVS. A value here is only a convenience for the
            developer's own bench device, and is used solely when nothing has
            been provisioned yet. Deliberately empty in the repo so no real
            credential is ever committed - your value lives in sdkconfig,
            which is gitignored.

    config BINLIGHT_WIFI_PASSWORD
        string "Wi-Fi Password (optional, development only)"
        default ""
        help
            See BINLIGHT_WIFI_SSID. Optional; provisioned credentials in NVS
            always take priority over anything compiled in.

    config BINLIGHT_WIFI_COMPILED_FALLBACK
        bool "Fall back to the compiled-in Wi-Fi credentials above"
        default n
        help
            Off by default, and leave it off unless you are actively working
            on a bench device.

            When on, a device with nothing provisioned in NVS joins the
            network named by BINLIGHT_WIFI_SSID instead of raising AutoAP.
            That makes an explicit "forget Wi-Fi" or factory reset look
            broken: the device wipes its credentials, reboots, silently picks
            up the build-time pair and rejoins the old network, never showing
            a setup AP.

            Setting the SSID string alone is deliberately not enough to turn
            this on - a value left behind in a gitignored sdkconfig should
            not be able to defeat provisioning by accident. See SPEC.md 6.

    config BINLIGHT_WIFI_MAXIMUM_RETRY
        int "Wi-Fi connect attempts at boot before falling back to AutoAP setup mode"
        default 10

    config BINLIGHT_SNTP_SERVER
        string "SNTP server hostname"
        default "pool.ntp.org"

    config BINLIGHT_TZ_STRING
        string "POSIX TZ string"
        default "AEST-10AEDT,M10.1.0/2,M4.1.0/3"
        help
            Melbourne, Australia: AEDT starts first Sunday of October,
            ends first Sunday of April.

    config BINLIGHT_OTA_MANIFEST_URL
        string "OTA update manifest URL"
        default "https://raw.githubusercontent.com/jxg81/bin-light/main/firmware/latest.json"
        help
            A small JSON file giving the published version, the image URL and
            a one-line note (SPEC.md 3.5). Served straight from the repo, so
            publishing an update is a git push plus a GitHub Release - there
            is no backend to run.

            Point this at your own fork if you maintain your own builds.

    config BINLIGHT_LED_GPIO
        int "WS2812 data GPIO"
        default 0

    config BINLIGHT_RESET_BUTTON_GPIO
        int "Reset button GPIO (-1 to disable)"
        default 2
        help
            Hold 3s to restart, 10s to factory reset (SPEC.md 3.12). The LEDs
            show which action is armed while you hold, so it needs no timing
            by feel.

            Wire a momentary push button between this pin and GND - the
            internal pull-up is enabled, so no external resistor is needed.

            Defaults to 2 (the pad marked D2 on the Seeed XIAO ESP32-C6),
            chosen because it is broken out, has no special function, and is
            NOT a strapping pin. Avoid GPIO 4, 5, 8, 9 and 15: those are
            strapping pins on the ESP32-C6, and a button held across a
            power-up would change how the chip boots (GPIO 9 in particular is
            the BOOT button - fine for bench testing, useless once the board
            is inside an enclosure).

            Set to -1 to disable the button entirely.

    config BINLIGHT_RESET_BUTTON_ACTIVE_LOW
        bool "Reset button reads low when pressed"
        default y
        help
            True for a momentary button wired between the pin and ground with
            a pull-up, which is how this one is wired.

    config BINLIGHT_ACTION_BUTTON_GPIO
        int "Action button GPIO (-1 to disable)"
        default 1
        help
            The capacitive touch pad on the outside of the enclosure
            (SPEC.md 3.12). A tap dismisses tonight's light if it is on, or
            shows the next collection for 30 seconds if it is off.

            Defaults to 1 (pad D1 on the Seeed XIAO ESP32-C6). Like the reset
            button, keep off the strapping pins: GPIO 4, 5, 8, 9 and 15.

            The ESP32-C6 has no capacitive-touch peripheral, so this expects a
            self-contained touch module (TTP223 or similar) presenting a plain
            digital level. Configure the module as MOMENTARY, not latching -
            the firmware decides what a tap means from the light's current
            state, so a module that latches would fight it.

    config BINLIGHT_ACTION_BUTTON_ACTIVE_LOW
        bool "Action button reads low when pressed"
        default n
        help
            Defaults to false: TTP223-style touch modules idle LOW and drive
            HIGH while touched - the opposite of the reset button. Set true if
            you use a plain push button to ground instead, or a module
            jumpered to invert its output.

endmenu
```
